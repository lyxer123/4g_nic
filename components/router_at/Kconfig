## components/router_at/Kconfig
```kconfig
menu "Router AT (MCU)"

    config ROUTER_AT_ENABLE
        bool "Enable router AT command subset (basic commands first)"
        default y
        help
            Text AT interface for an external MCU. When the AT UART matches the console UART,
            lines starting with AT are handled by router_at; other lines stay with serial_cli / PCAPI.

    config ROUTER_AT_UART_NUM
        int "UART port number used for AT (0 / 1 / 2)"
        default 0
        range 0 2
        depends on ROUTER_AT_ENABLE
        help
            Development: 0 shares the same UART as the ESP console / serial_cli (prefix AT… only).
            Production: often 1 or 2 on a dedicated header. Must match board wiring.

    config ROUTER_AT_UART_BAUD
        int "Baud rate when AT uses a dedicated UART (not console-shared)"
        default 115200
        depends on ROUTER_AT_ENABLE

    config ROUTER_AT_UART_TX_GPIO
        int "TX GPIO when AT uses a dedicated UART"
        default 4
        range -1 48
        depends on ROUTER_AT_ENABLE
        help
            Used only when ROUTER_AT_UART_NUM differs from CONFIG_ESP_CONSOLE_UART_NUM.
            Set -1 to skip uart_set_pin (use IDF defaults for that port — board-dependent).

    config ROUTER_AT_UART_RX_GPIO
        int "RX GPIO when AT uses a dedicated UART"
        default 5
        range -1 48
        depends on ROUTER_AT_ENABLE
        help
            Used only when ROUTER_AT_UART_NUM differs from CONFIG_ESP_CONSOLE_UART_NUM.
            Set -1 to skip uart_set_pin.

endmenu
```

## components/router_ppp/Kconfig
```kconfig
menu "Router PPPoS"

    config ROUTER_PPP_ENABLE
        bool "Enable router-side PPPoS server for external MCU"
        default n
        help
            Start a PPP-over-Serial server on a dedicated UART so an external MCU
            can establish a PPP session with the ESP32 router.

    config ROUTER_PPP_UART_NUM
        int "UART port used for PPPoS server"
        default 2
        range 0 2
        depends on ROUTER_PPP_ENABLE
        help
            UART port for the PPPoS server. This port must not share the console
            UART or the router AT UART when PPPoS is enabled.

    config ROUTER_PPP_UART_BAUD
        int "Baud rate for PPPoS UART"
        default 115200
        depends on ROUTER_PPP_ENABLE

    config ROUTER_PPP_UART_TX_GPIO
        int "TX GPIO for PPPoS UART"
        default -1
        range -1 48
        depends on ROUTER_PPP_ENABLE
        help
            Set to -1 to use the UART default pin assignment.

    config ROUTER_PPP_UART_RX_GPIO
        int "RX GPIO for PPPoS UART"
        default -1
        range -1 48
        depends on ROUTER_PPP_ENABLE
        help
            Set to -1 to use the UART default pin assignment.

endmenu
```

## components/system/Kconfig
```kconfig
menu "System options"

    config SYSTEM_HW_DETECT_W5500
        bool "Probe W5500 (VERSIONR) before bridge SPI Ethernet init"
        default y
        depends on ETH_SPI_ETHERNET_W5500 && BRIDGE_USE_SPI_ETHERNET
        help
            Briefly owns the SPI bus, pulses PHY RST if configured, reads VERSIONR (expect 0x04).
            Must run before esp_bridge_create_all_netif(). Uses CONFIG_BRIDGE_ETH_SPI_* pins.

    config SYSTEM_USB_CAT1_DETECT
        bool "Boot USB Cat.1 / LTE modem enumeration (independent of Bridge Modem netif)"
        default y
        depends on SOC_USB_OTG_SUPPORTED
        help
            Runs on every boot before the bridge creates netifs. Does NOT require "External netif Modem"
            or BRIDGE_SERIAL_VIA_USB: use this to detect USB LTE hardware for logs and the web UI even when
            the current build uses only STA/Ethernet uplink. Installs usb_host briefly, matches VID/PID
            (ML307C 0x2ecc:0x3012 + optional extras), then uninstalls. Disable if this conflicts with
            TinyUSB or another USB stack on the same OTG port.

    config SYSTEM_USB_CAT1_ENUM_TIMEOUT_MS
        int "USB modem probe: minimum duration per round (ms)"
        default 10000
        depends on SYSTEM_USB_CAT1_DETECT
        range 500 30000
        help
          Each probe round runs for at least this long unless a matching modem is found earlier.
          Worst-case time is approximately SYSTEM_USB_CAT1_PROBE_ROUNDS times this value.

    config SYSTEM_USB_CAT1_PROBE_ROUNDS
        int "USB modem probe: number of rounds before giving up"
        default 3
        depends on SYSTEM_USB_CAT1_DETECT
        range 1 8
        help
          After each full round (ENUM_TIMEOUT_MS), starts another if not yet successful. Stops immediately when accepted.

    config SYSTEM_USB_CAT1_ENABLE_GPIO
        int "Cat1 modem power/enable GPIO (-1 = unused)"
        default -1
        depends on SYSTEM_USB_CAT1_DETECT
        range -1 48
        help
            Many boards use a GPIO to enable DC-DC or nRESET (e.g. EN). Assert this level before
            usb_host enumerates so the module can power up and appear on USB. Match your schematic.

    config SYSTEM_USB_CAT1_ENABLE_ACTIVE_HIGH
        bool "Enable GPIO active high (uncheck if EN is active-low)"
        default y
        depends on SYSTEM_USB_CAT1_DETECT

    config SYSTEM_USB_CAT1_ENABLE_SETTLE_MS
        int "Delay after enable GPIO before USB enumerate (ms)"
        default 2000
        depends on SYSTEM_USB_CAT1_DETECT
        range 0 30000
        help
            USB host runs after this delay so the modem can exit reset and boot firmware.

    config SYSTEM_USB_CAT1_EXTRA_VID
        hex "Extra USB VID to accept (0=disable)"
        default 0
        depends on SYSTEM_USB_CAT1_DETECT
        help
            If non-zero with EXTRA_PID, accept this VID/PID in addition to built-in table (verify with lsusb for ML307C).

    config SYSTEM_USB_CAT1_EXTRA_PID
        hex "Extra USB PID to accept (0=disable)"
        default 0
        depends on SYSTEM_USB_CAT1_DETECT

    config SYSTEM_USB_CAT1_ACCEPT_ANY_CDC
        bool "Also accept any device with CDC COMM+DATA interfaces (less reliable)"
        default n
        depends on SYSTEM_USB_CAT1_DETECT
        help
          If y, a composite CDC modem without a listed VID/PID may be reported as present. Prefer fixing VID/PID table.

    config SYSTEM_ETH_WAN_USE_STATIC_IP
        bool "ETH_WAN use static IPv4 (skip DHCP)"
        default n
        help
            When set, applies the addresses below after Ethernet link-up instead of DHCP.
            Useful when the router has no DHCP or for debugging L3.

    config SYSTEM_ETH_WAN_STATIC_IP_STR
        string "ETH_WAN static IP address"
        default "192.168.137.105"
        depends on SYSTEM_ETH_WAN_USE_STATIC_IP

    config SYSTEM_ETH_WAN_STATIC_GW_STR
        string "ETH_WAN default gateway"
        default "192.168.137.1"
        depends on SYSTEM_ETH_WAN_USE_STATIC_IP

    config SYSTEM_ETH_WAN_STATIC_NM_STR
        string "ETH_WAN netmask"
        default "255.255.255.0"
        depends on SYSTEM_ETH_WAN_USE_STATIC_IP

    config SYSTEM_ETH_WAN_DNS_USE_GATEWAY_AS_MAIN
        bool "Use default gateway as primary DNS (recommended for Windows ICS / shared Ethernet)"
        default y
        depends on SYSTEM_ETH_WAN_USE_STATIC_IP
        help
            ICS (192.168.x.1) usually proxies DNS only when clients use the host as resolver; direct UDP/53
            to 114.114.114.114 etc. often fails. Uncheck when your gateway is a normal router and you want a
            custom primary DNS (then set ETH_WAN static DNS below).

    config SYSTEM_ETH_WAN_STATIC_DNS_MAIN_STR
        string "ETH_WAN static DNS (main), IPv4"
        default "114.114.114.114"
        depends on SYSTEM_ETH_WAN_USE_STATIC_IP && !SYSTEM_ETH_WAN_DNS_USE_GATEWAY_AS_MAIN
        help
            Ignored when "Use default gateway as primary DNS" is enabled.

    config SYSTEM_ETH_WAN_STATIC_DNS_BACKUP_STR
        string "ETH_WAN static DNS (backup), IPv4"
        default "8.8.8.8"
        depends on SYSTEM_ETH_WAN_USE_STATIC_IP

    config SYSTEM_ETH_UPLINK_HTTP_CHECK
        bool "After ETH_WAN has IPv4, run HTTP probe (baidu: IP path + optional DNS name)"
        default y
        help
            First uses a configurable baidu CDN IPv4 + Host header (no DNS). Then tries http://www.baidu.com/
            to test DNS. On ICS, UDP/53 to public resolvers is often blocked while TCP/80 still works.

    config SYSTEM_ETH_UPLINK_CHECK_BAIDU_IP_STR
        string "HTTP WAN probe: baidu edge IPv4 (CDN; change if probe breaks)"
        default "39.156.66.10"
        depends on SYSTEM_ETH_UPLINK_HTTP_CHECK

endmenu
```

## main/Kconfig.projbuild
```kconfig
menu "Application Wi-Fi (STA)"
    depends on BRIDGE_EXTERNAL_NETIF_STATION

    config APP_WIFI_STA_SSID
        string "Default STA SSID (applied before Wi-Fi connect)"
        default "HONOR300"
        help
            Written to Wi-Fi STA after ESP-IoT-Bridge creates interfaces. Override via web UI / NVS (wifi_cfg) if you use that path.

    config APP_WIFI_STA_PASSWORD
        string "Default STA password"
        default "abc7178377"

    config APP_STA_BAIDU_HTTP_PROBE
        bool "After STA got IP, HTTP GET www.baidu.com (logs status)"
        default y
        help
            Spawns a short task to verify DNS and TCP/80 through the Wi-Fi uplink.
endmenu
```

## mcuppp/esp32/esp-idf/sdkconfig.defaults
```kconfig
# Minimum settings for ESP-IDF PPP client example
CONFIG_LWIP_PPP_SUPPORT=y
CONFIG_LWIP_PPP_MAXIDLE=0
```
