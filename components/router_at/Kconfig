## sdkconfig.defaults
```kconfig
#
# Serial flasher config
#
CONFIG_ESPTOOLPY_FLASHSIZE_4MB=y

#
# Partition Table: 4MB Flash, partitions_4mb.csv; 16MB boards use partitions_large.csv
#
CONFIG_PARTITION_TABLE_CUSTOM=y
CONFIG_PARTITION_TABLE_CUSTOM_FILENAME="partitions_4mb.csv"
CONFIG_PARTITION_TABLE_FILENAME="partitions_4mb.csv"
CONFIG_PARTITION_TABLE_OFFSET=0x10000
CONFIG_PARTITION_TABLE_MD5=y

# Temporary Fix for Timer Overflows
CONFIG_FREERTOS_TIMER_TASK_STACK_DEPTH=4096

#
# ESP32-specific
#
CONFIG_MEMMAP_SMP=y
CONFIG_ESP_SYSTEM_EVENT_TASK_STACK_SIZE=4096

# UART Console Configuration
CONFIG_ESP_CONSOLE_UART_NUM=0
CONFIG_ESP_CONSOLE_UART_BAUDRATE=115200

# Dual core mode for better PSRAM stability
# CONFIG_FREERTOS_UNICORE is not set
CONFIG_FREERTOS_HZ=1000
# Dashboard CPU%: FreeRTOS run-time stats (compatible with esp-iot-bridge optional stats)
CONFIG_FREERTOS_USE_TRACE_FACILITY=y
CONFIG_FREERTOS_GENERATE_RUN_TIME_STATS=y
CONFIG_FREERTOS_RUN_TIME_STATS_USING_ESP_TIMER=y
CONFIG_FREERTOS_ENABLE_TASK_SNAPSHOT=y
# Keep snapshot helpers in IRAM/default section during early boot (PSRAM + XIP sensitive window).
# CONFIG_FREERTOS_PLACE_SNAPSHOT_FUNS_INTO_FLASH is not set

# Watchdogs: recover from deadlock; timeouts relaxed for PPP / heavy lwIP load
CONFIG_ESP_INT_WDT=y
CONFIG_ESP_INT_WDT_TIMEOUT_MS=1000
CONFIG_ESP_TASK_WDT_INIT=y
CONFIG_ESP_TASK_WDT_TIMEOUT_S=15
# Second-stage bootloader RTC WDT (rst:0x10 RTCWDT_RTC_RST). Default 9000ms is too short when
# SPIRAM memtest + external BSS/RODATA init runs before the scheduler feeds the RTC WDT.
# Keep above worst-case early boot; unrelated to CONFIG_ESP_TASK_WDT_TIMEOUT_S.
CONFIG_BOOTLOADER_WDT_TIME_MS=30000

# Raise socket/TCP limits for router/NAPT under load (reduce resource exhaustion)
CONFIG_LWIP_MAX_SOCKETS=24
CONFIG_LWIP_MAX_ACTIVE_TCP=32
CONFIG_LWIP_MAX_LISTENING_TCP=16

# LWIP
CONFIG_LWIP_L2_TO_L3_COPY=y
CONFIG_LWIP_IP_FORWARD=y
CONFIG_LWIP_IPV4_NAPT=y
CONFIG_LWIP_TCP_MSS=1460
CONFIG_LWIP_TCP_OVERSIZE_MSS=y
# Larger TCPIP mbox reduces "pppos_input_tcpip failed with -1" when USB LTE + Wi-Fi load the stack.
CONFIG_LWIP_TCPIP_RECVMBOX_SIZE=64
CONFIG_LWIP_TCPIP_TASK_STACK_SIZE=6144
# SPI Ethernet + DHCP: ARP-check-on-offer can stall; optional client-id can upset some routers.
# CONFIG_LWIP_DHCP_DOES_ARP_CHECK is not set
CONFIG_LWIP_DHCP_DISABLE_CLIENT_ID=y

# Override some defaults to enable PPP
CONFIG_LWIP_PPP_SUPPORT=y
CONFIG_LWIP_PPP_PAP_SUPPORT=y
CONFIG_LWIP_PPP_SERVER_SUPPORT=y
# Do not enable IPV6 in dte<->dce link local
CONFIG_LWIP_PPP_ENABLE_IPV6=n
# Disable legacy API
CONFIG_MODEM_LEGACY_API=n

CONFIG_ETH_DMA_BUFFER_SIZE=1600

CONFIG_ETH_SPI_ETHERNET_DM9051=y
CONFIG_ETH_SPI_ETHERNET_KSZ8851SNL=y
CONFIG_ETH_SPI_ETHERNET_W5500=y

CONFIG_ESP_SYSTEM_MEMPROT_FEATURE=n

CONFIG_ESP_MAIN_TASK_STACK_SIZE=5120

# Boot-time USB LTE modem enumeration for logs / web UI. Does not require BRIDGE_EXTERNAL_NETIF_MODEM.
CONFIG_SYSTEM_USB_CAT1_DETECT=y
# Many Cat1 modules enumerate after USB reset + power ramp; 4s is often too short.
CONFIG_SYSTEM_USB_CAT1_ENUM_TIMEOUT_MS=10000
CONFIG_SYSTEM_USB_CAT1_PROBE_ROUNDS=3
# Board: GPIO21 drives modem EN (power on). Set -1 if module is always powered.
CONFIG_SYSTEM_USB_CAT1_ENABLE_GPIO=21
CONFIG_SYSTEM_USB_CAT1_ENABLE_ACTIVE_HIGH=y
CONFIG_SYSTEM_USB_CAT1_ENABLE_SETTLE_MS=2000
# No USB modem at boot -> do not create PPP netif (no "Force reset 4g board" / esp_modem wait).
CONFIG_SYSTEM_ALWAYS_CREATE_MODEM_NETIF=n

# Required: runtime skips W5500 bridge netifs when chip absent (system_bridge_init_netifs_from_hw).
CONFIG_SYSTEM_HW_DETECT_W5500=y

# ESP-IoT-Bridge: compile-time capability set. Runtime WAN/LAN via NVS work_mode + Mode Manager.
# Option A (below): AUTO_WAN_OR_LAN - single menu toggle for shared-MAC ETH_WAN + ETH_LAN.
# Option B (Route B-1): set # CONFIG_BRIDGE_NETIF_ETHERNET_AUTO_WAN_OR_LAN is not set
#   and enable both CONFIG_BRIDGE_EXTERNAL_NETIF_ETHERNET=y and
#   CONFIG_BRIDGE_DATA_FORWARDING_NETIF_ETHERNET=y (see managed_components/.../LOCAL_PATCHES_README.md).
CONFIG_BRIDGE_EXTERNAL_NETIF_STATION=y
CONFIG_BRIDGE_EXTERNAL_NETIF_MODEM=y
# SoftAP: disable PMF to avoid SA Query / handshake issues with some STA drivers (log "attack!!!" / reason 15).
CONFIG_BRIDGE_WIFI_PMF_DISABLE=y
# CONFIG_BRIDGE_EXTERNAL_NETIF_ETHERNET is not set
CONFIG_BRIDGE_NETIF_ETHERNET_AUTO_WAN_OR_LAN=y
#
# ML307C (USB Cat.1): VID 0x2ecc, PID 0x3012 - same as system_usb_cat1_detect whitelist.
# When enabling CONFIG_BRIDGE_EXTERNAL_NETIF_MODEM + CONFIG_BRIDGE_SERIAL_VIA_USB, set in menuconfig
# under IoT-Bridge - USB Configuration (defaults there are Quectel 0x2C7C/0x0296, not ML307C):
#   CONFIG_BRIDGE_MODEM_USB_VID=0x2ecc
#   CONFIG_BRIDGE_MODEM_USB_PID=0x3012
#   CONFIG_BRIDGE_MODEM_USB_INTERFACE_NUMBER=2
# Reference: sdkconfig.old in this repo already contained the above VID/PID.
CONFIG_BRIDGE_DATA_FORWARDING_NETIF_SOFTAP=y
# With AUTO_WAN_OR_LAN=y, keep FORWARDING_ETHERNET off. With B-1, set FORWARDING_ETHERNET=y and EXTERNAL_ETHERNET=y.
# CONFIG_BRIDGE_DATA_FORWARDING_NETIF_ETHERNET is not set
# W5500 emac addr: match board (Arduino ETH.begin PHY addr often 1)
CONFIG_BRIDGE_ETH_SPI_PHY_ADDR0=1
CONFIG_BRIDGE_ETH_SPI_CLOCK_MHZ=10

# No ETH_WAN in this topology; optional wired-WAN diagnostics off.
# CONFIG_SYSTEM_ETH_WAN_USE_STATIC_IP is not set
# CONFIG_SYSTEM_ETH_UPLINK_HTTP_CHECK is not set

# Router AT: UART0 = share with console/serial_cli (lines starting with AT); use UART1/2 + pins for dedicated MCU port.
CONFIG_ROUTER_AT_ENABLE=y
CONFIG_ROUTER_AT_UART_NUM=0

# PPPoS server for MCU access over dedicated UART
CONFIG_ROUTER_PPP_ENABLE=n
CONFIG_ROUTER_PPP_UART_NUM=2
CONFIG_ROUTER_PPP_UART_BAUD=115200
CONFIG_ROUTER_PPP_UART_TX_GPIO=-1
CONFIG_ROUTER_PPP_UART_RX_GPIO=-1

# PPP: do not block boot forever when SIM has no data / wrong APN (see main/Kconfig.projbuild).
CONFIG_BRIDGE_MODEM_WAIT_IP_TIMEOUT_MS=120000

#
# Memory Optimizations - Critical for ESP32-S3 with limited RAM
#

# HTTP Server: Reduce stack to minimum required
CONFIG_ESP_HTTPD_STACK_SIZE=4096

# LWIP: Reduce memory footprint (balance performance vs RAM)
CONFIG_LWIP_MAX_SOCKETS=16
CONFIG_LWIP_MAX_ACTIVE_TCP=24
CONFIG_LWIP_MAX_LISTENING_TCP=12
CONFIG_LWIP_TCP_SND_BUF_DEFAULT=2920
CONFIG_LWIP_TCP_WND_DEFAULT=2920
CONFIG_LWIP_TCPIP_RECVMBOX_SIZE=32
CONFIG_LWIP_TCPIP_TASK_STACK_SIZE=4096

# Reduce system task stacks
CONFIG_ESP_SYSTEM_EVENT_TASK_STACK_SIZE=2048
CONFIG_ESP_MAIN_TASK_STACK_SIZE=4096
CONFIG_FREERTOS_TIMER_TASK_STACK_DEPTH=2048

# WiFi: Reduce buffers
CONFIG_ESP_WIFI_STATIC_RX_BUFFER_NUM=6
CONFIG_ESP_WIFI_DYNAMIC_RX_BUFFER_NUM=12
CONFIG_ESP_WIFI_DYNAMIC_TX_BUFFER_NUM=12
CONFIG_ESP_WIFI_TX_BA_WIN=6
CONFIG_ESP_WIFI_RX_BA_WIN=6

#
# PSRAM Configuration - Based on Lua-uPC (stable with dual core)
# ESP32-S3 with 8MB PSRAM, optimized for stability
#
# Keep SPIRAM_BOOT_INIT + BOOT_HW_INIT on whenever PSRAM is used (heap WiFi offload, caps, etc.).
#
CONFIG_SPIRAM=y
# CONFIG_SPIRAM_MODE_QUAD is not set
CONFIG_SPIRAM_MODE_OCT=y
CONFIG_SPIRAM_TYPE_AUTO=y
# CONFIG_SPIRAM_SPEED_40M is not set
CONFIG_SPIRAM_SPEED_80M=y
CONFIG_SPIRAM_SPEED=80
# CONFIG_SPIRAM_ECC_ENABLE is not set
CONFIG_SPIRAM_BOOT_HW_INIT=y
CONFIG_SPIRAM_BOOT_INIT=y

# PSRAM: USE_MEMMAP on ESP-IDF v5.2.x avoids esp_psram_extram_add_to_heap_allocator (heap_caps_add_region_with_caps
# IllegalInstruction on some S3 + Octal builds; fixed in newer IDF, see IDFGH-14757). Trade-off: no SPIRAM heap, so
# CONFIG_SPIRAM_TRY_ALLOCATE_WIFI_LWIP is unavailable (requires USE_MALLOC or USE_CAPS_ALLOC).
CONFIG_SPIRAM_USE_MEMMAP=y
# CONFIG_SPIRAM_USE_CAPS_ALLOC is not set
# CONFIG_SPIRAM_USE_MALLOC is not set
# CONFIG_SPIRAM_TRY_ALLOCATE_WIFI_LWIP is not set

# External .bss in PSRAM (SPIRAM_ALLOW_BSS_SEG_EXTERNAL_MEMORY) runs a large memset in call_start_cpu0
# before esp_clk_init. On some 5.2.x + Octal PSRAM + WiFi linker layouts this has caused IllegalInstruction
# in esp_clk_init (ICache/garbage instructions). Keep internal BSS; after upgrading IDF, revisit malloc + TRY_ALLOCATE.
# CONFIG_SPIRAM_ALLOW_BSS_SEG_EXTERNAL_MEMORY is not set
# Do NOT enable SPIRAM_ALLOW_NOINIT_SEG_EXTERNAL_MEMORY on ESP-IDF v5.2.x: IDFGH-14757 (fixed v5.3+ PR #15513).
# CONFIG_SPIRAM_ALLOW_NOINIT_SEG_EXTERNAL_MEMORY is not set
# Task stacks MUST stay in internal RAM for stability (cache off during flash ops)
# CONFIG_SPIRAM_ALLOW_STACK_EXTERNAL_MEMORY is not set

# C11 atomics in PSRAM workaround (must appear in sdkconfig, not only defaults, after menuconfig runs).
# Helps heap/spinlock paths when PSRAM is in the 0x3cxxxxxx map; relevant to early esp_psram_extram_add_to_heap_allocator.
CONFIG_STDATOMIC_S32C1I_SPIRAM_WORKAROUND=y

# Skip full PSRAM walk at boot: it runs while the 2nd-stage bootloader RTC WDT is still armed
# (until start_cpu0_default disables it) and can exceed the default 9000 ms if the bootloader
# was not reflashed after increasing CONFIG_BOOTLOADER_WDT_TIME_MS.
# CONFIG_SPIRAM_MEMTEST is not set

#
# Dual Core Mode (REQUIRED for PSRAM stability)
# CONFIG_FREERTOS_UNICORE is not set
CONFIG_FREERTOS_HZ=1000

#
# LWIP Configuration - Based on Lua-uPC
#
CONFIG_LWIP_ENABLE=y
CONFIG_LWIP_IP_FORWARD=y
CONFIG_LWIP_IPV4_NAPT=y
CONFIG_LWIP_IPV4_NAPT_PORTMAP=y
CONFIG_LWIP_FALLBACK_DNS_SERVER_SUPPORT=y
CONFIG_LWIP_FALLBACK_DNS_SERVER_ADDRESS="114.114.114.114"
CONFIG_LWIP_LOCAL_HOSTNAME="espressif"
CONFIG_LWIP_TCPIP_TASK_PRIO=18
CONFIG_LWIP_TIMERS_ONDEMAND=y
CONFIG_LWIP_MAX_SOCKETS=10
CONFIG_LWIP_SO_REUSE=y
CONFIG_LWIP_SO_REUSE_RXTOALL=y
CONFIG_LWIP_IP_DEFAULT_TTL=64
CONFIG_LWIP_IP4_FRAG=y
CONFIG_LWIP_IP6_FRAG=y
CONFIG_LWIP_IP_REASS_MAX_PBUFS=10
CONFIG_LWIP_TCPIP_RECVMBOX_SIZE=32
CONFIG_LWIP_TCPIP_TASK_STACK_SIZE=3072
CONFIG_LWIP_TCPIP_TASK_AFFINITY_NO_AFFINITY=y

# DHCP
CONFIG_LWIP_DHCP_DOES_ARP_CHECK=y
CONFIG_LWIP_DHCP_DISABLE_VENDOR_CLASS_ID=y
CONFIG_LWIP_DHCP_OPTIONS_LEN=69
CONFIG_LWIP_DHCPS=y
CONFIG_LWIP_DHCPS_LEASE_UNIT=60
CONFIG_LWIP_DHCPS_MAX_STATION_NUM=8
CONFIG_LWIP_DHCPS_STATIC_ENTRIES=y
CONFIG_LWIP_DHCPS_ADD_DNS=y

# TCP
CONFIG_LWIP_MAX_ACTIVE_TCP=16
CONFIG_LWIP_MAX_LISTENING_TCP=16
CONFIG_LWIP_TCP_HIGH_SPEED_RETRANSMISSION=y
CONFIG_LWIP_TCP_MSS=1440
CONFIG_LWIP_TCP_SND_BUF_DEFAULT=5760
CONFIG_LWIP_TCP_WND_DEFAULT=5760
CONFIG_LWIP_TCP_RECVMBOX_SIZE=6
CONFIG_LWIP_TCP_ACCEPTMBOX_SIZE=6

# UDP
CONFIG_LWIP_MAX_UDP_PCBS=16
CONFIG_LWIP_UDP_RECVMBOX_SIZE=6

# PPP (for 4G)
CONFIG_LWIP_PPP_SUPPORT=y
CONFIG_LWIP_PPP_ENABLE_IPV4=y
CONFIG_LWIP_PPP_ENABLE_IPV6=y

# Minimal HTTP server
CONFIG_HTTPD_MAX_REQ_HDR_LEN=512
CONFIG_HTTPD_MAX_URI_LEN=256
```

## sdkconfig.defaults.esp32s3
```kconfig
# Do not force unicore here: main sdkconfig.defaults uses dual-core for ESP32-S3 + OPI PSRAM.
# Forcing UNICORE=y can be merged after multicore defaults and break PSRAM / CPU1 startup.
# CONFIG_FREERTOS_UNICORE is not set

#
# TinyUSB Stack
#
CONFIG_TINYUSB=y
CONFIG_TINYUSB_DEBUG_LEVEL=0

#
# USB Network Class (RNDIS, ECM)
#
CONFIG_TINYUSB_NET_ENABLED=y
CONFIG_TINYUSB_RNDIS_VENDOR="Espressif Incorporated"
CONFIG_TINYUSB_NET_ECM=y

#
# ESP32S3-Specific
#
CONFIG_ESP_DEFAULT_CPU_FREQ_MHZ_240=y
CONFIG_ESP_DEFAULT_CPU_FREQ_MHZ=240

#
# OPI Octal PSRAM @ 80MHz (memory-mapped; no SPIRAM heap on ESP-IDF v5.2.x workaround).
# ESP-IDF 5.2.x + Octal PSRAM: esp_psram_extram_add_to_heap_allocator can fault in
# heap_caps_add_region_with_caps (see IDFGH-14757 / upgrade to v5.3+ for unified heap fix).
# USE_MEMMAP skips that path; WiFi/lwIP cannot use CONFIG_SPIRAM_TRY_ALLOCATE_WIFI_LWIP (Kconfig requires malloc/caps).
# If your module has NO PSRAM, comment out all CONFIG_SPIRAM* below and fullclean rebuild.
#
CONFIG_SPIRAM=y
CONFIG_SPIRAM_MODE_OCT=y
CONFIG_SPIRAM_SPEED_80M=y
CONFIG_SPIRAM_BOOT_HW_INIT=y
CONFIG_SPIRAM_BOOT_INIT=y
CONFIG_SPIRAM_USE_MEMMAP=y
# CONFIG_SPIRAM_USE_CAPS_ALLOC is not set
# CONFIG_SPIRAM_USE_MALLOC is not set
# CONFIG_SPIRAM_TRY_ALLOCATE_WIFI_LWIP is not set
CONFIG_STDATOMIC_S32C1I_SPIRAM_WORKAROUND=y

CONFIG_USB_TASK_CORE_ID=1

#
# USB Host CDC options
#
CONFIG_CDC_SEND_DTE_ACTIVE=n
CONFIG_CDC_BULK_OUT_URB_BUFFER_SIZE=1536
CONFIG_CDC_BULK_IN_URB_BUFFER_SIZE=1536
CONFIG_CDC_BULK_IN_URB_NUM=4
CONFIG_CDC_BULK_OUT_URB_NUM=4

CONFIG_TINYUSB_NET_MODE_ECM_RNDIS=y

CONFIG_TINYUSB_TASK_AFFINITY_CPU0=y
CONFIG_TINYUSB_INIT_IN_DEFAULT_TASK=y
CONFIG_TINYUSB_NET_MODE_NCM=y
```

## spiNetwork/esp-idf_example/sdkconfig.defaults
```kconfig
# ESP-IDF Configuration for SPI Network Bridge
CONFIG_ESP32_WROOM_1=y

# Bridge Configuration
CONFIG_BRIDGE_DATA_FORWARDING_NETIF_SPI=y
CONFIG_BRIDGE_EXTERNAL_NETIF_STATION=y

# SPI Configuration
CONFIG_SPI_MASTER_IN_IRAM=y
CONFIG_SPI_SLAVE_IN_IRAM=y

# WiFi Configuration  
CONFIG_ESP32_WIFI_SW_COEXIST_ENABLE=y
CONFIG_ESP32_WIFI_STATIC_RX_BUFFER_NUM=10
CONFIG_ESP32_WIFI_DYNAMIC_RX_BUFFER_NUM=16
CONFIG_ESP32_WIFI_DYNAMIC_TX_BUFFER_NUM=32

# Network Stack Configuration
CONFIG_LWIP_TCPIP_RECVMBOX_SIZE=32
CONFIG_LWIP_UDP_RECVMBOX_SIZE=6
CONFIG_LWIP_TCP_RECVMBOX_SIZE=6

# Memory Configuration
CONFIG_FREERTOS_HZ=1000

# Log Configuration
CONFIG_LOG_DEFAULT_LEVEL_DEBUG=y
```

## spiNetwork/esp32_wroom_host/sdkconfig.defaults
```kconfig
# ESP32 SPI Host Bridge Configuration
CONFIG_IDF_TARGET_ESP32=y

# WiFi Configuration
CONFIG_ESP32_WIFI_SW_COEXIST_ENABLE=y

# SPI Configuration
CONFIG_SPI_MASTER_IN_IRAM=y

# Network Stack Configuration
CONFIG_LWIP_TCPIP_RECVMBOX_SIZE=32
CONFIG_LWIP_UDP_RECVMBOX_SIZE=6
CONFIG_LWIP_TCP_RECVMBOX_SIZE=6

# Memory Configuration
CONFIG_FREERTOS_HZ=1000

# Log Configuration
CONFIG_LOG_DEFAULT_LEVEL_INFO=y
```
